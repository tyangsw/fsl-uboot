## board/freescale/nai68ppc2/Kconfig
```kconfig
if TARGET_NAI68PPC2

config SYS_BOARD
	default "nai68ppc2"

config SYS_VENDOR
	default "freescale"

config SYS_CONFIG_NAME
	default "NAI68PPC2"

endif
```

## board/freescale/nai6xppc2/Kconfig
```kconfig
if TARGET_NAI6XPPC2

config SYS_BOARD
	default "nai6xppc2"

config SYS_VENDOR
	default "freescale"

config SYS_CONFIG_NAME
	default "NAI6xPPC2"

endif
```
